## drivers/hisi/modem_hi3xxx/drv/Kconfig
```kconfig
menu "Modem(HI6930) Drivers"
source "drivers/hisi/modem_hi3xxx/drv/icc/Kconfig"
source "drivers/hisi/modem_hi3xxx/drv/ipc/Kconfig"
source "drivers/hisi/modem_hi3xxx/drv/adp/Kconfig"
source "drivers/hisi/modem_hi3xxx/drv/sync/Kconfig"
source "drivers/hisi/modem_hi3xxx/drv/dsp/Kconfig"
source "drivers/hisi/modem_hi3xxx/drv/hkadc/Kconfig"
source "drivers/hisi/modem_hi3xxx/drv/hwadp/Kconfig"
source "drivers/hisi/modem_hi3xxx/drv/loadm/Kconfig"
source "drivers/hisi/modem_hi3xxx/drv/balong_fs/Kconfig"
source "drivers/hisi/modem_hi3xxx/drv/onoff/Kconfig"
source "drivers/hisi/modem_hi3xxx/drv/sec/Kconfig"
source "drivers/hisi/modem_hi3xxx/drv/rfile/Kconfig"
source "drivers/hisi/modem_hi3xxx/drv/rtc/Kconfig"
source "drivers/hisi/modem_hi3xxx/drv/cshell/Kconfig"
source "drivers/hisi/modem_hi3xxx/drv/mem/Kconfig"
source "drivers/hisi/modem_hi3xxx/drv/udi/Kconfig"
source "drivers/hisi/modem_hi3xxx/drv/gpio/Kconfig"
source "drivers/hisi/modem_hi3xxx/drv/keyboard/Kconfig"
source "drivers/hisi/modem_hi3xxx/drv/balong_timer/Kconfig"
source "drivers/hisi/modem_hi3xxx/drv/cipher/Kconfig"
source "drivers/hisi/modem_hi3xxx/drv/nvim/Kconfig"
source "drivers/hisi/modem_hi3xxx/drv/ios/Kconfig"
source "drivers/hisi/modem_hi3xxx/drv/efuse/Kconfig"
source "drivers/hisi/modem_hi3xxx/drv/reset/Kconfig"
source "drivers/hisi/modem_hi3xxx/drv/lowpower_mntn/Kconfig"
source "drivers/hisi/modem_hi3xxx/drv/temperature/Kconfig"
source "drivers/hisi/modem_hi3xxx/drv/misc/Kconfig"
source "drivers/hisi/modem_hi3xxx/drv/pm_om/Kconfig"
endmenu
```

## drivers/hisi/modem_hi6xxx/balong_oam_ps/Kconfig
```kconfig
config HISI_BALONG_MODEM_HI6XXX
	bool "Hisilicon platform modem support"
	default n
	help
	  Say yes here to support the hisilicon platform modem
```

## drivers/hisi/modem_hi6xxx/drv/Kconfig
```kconfig
config HI6XXX_MODEM_MULTICORE
	bool "Kirin620 modem part for multicore support"
	select HI6XXX_MAILBOX_MULTICORE
	default n
	help
	  Say yes here to support the Kirin620 modem part for multicore lib


source "drivers/hisi/modem_hi6xxx/drv/acore/Kconfig"
```

## drivers/huawei_platform/power/charger/Kconfig
```kconfig
config HUAWEI_CHARGER
	bool "huawei charger"
	default n
config BQ2419X_CHARGER
	bool "bq2419x charger"
	default n
config BQ2429X_CHARGER
	bool "bq2429x charger"
	default n
config BQ25892_CHARGER
	bool "bq25892 charger"
	default n
config GRACE_SELECT_2A_1A_AC
        bool "auto select 2A or 1A AC on GRACE"
        default n
```


/**
 * Huawei Ltd.
 * PhosphorV660
 */

/dts-v1/;

/include/ "fastboot.dtsi"
/include/ "GRACE_UL_V4_config.dtsi"
/include/ "GRACE_UL_VN1_pin.dtsi"
/include/ "GRACE_UL_VN1_modem_pin.dtsi"
///include/ "GRACE_UL_VN1_charger.dtsi"
///include/ "GRACE_UL_VN1_pmic.dtsi"
///include/ "GRACE_UL_VN1_gpio_logic.dtsi"

/ {
	hisi,boardid = <1 4 3 4 >;
	hisi,boardname = "GRACE_UL_VN1";
	hisi,modem_id = <0x3EB07000>;
	hisi,config_profile = "normal";

	/*ois device*/
	hisi,lc8981 {
		hisi,ois-support = <1>;
		status = "ok";
	};
};


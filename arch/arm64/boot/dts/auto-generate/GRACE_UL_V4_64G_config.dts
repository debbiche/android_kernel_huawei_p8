
/**
 * Huawei Ltd.
 * PhosphorV660
 */

/dts-v1/;

/include/ "fastboot.dtsi"
/include/ "GRACE_UL_V4_config.dtsi"
/include/ "GRACE_UL_V4_64G_pin.dtsi"
/include/ "GRACE_UL_V4_64G_hi6402_pin.dtsi"
/include/ "GRACE_UL_V4_64G_modem_pin.dtsi"
///include/ "GRACE_UL_V4_64G_charger.dtsi"
///include/ "GRACE_UL_V4_64G_pmic.dtsi"
///include/ "GRACE_UL_V4_64G_gpio_logic.dtsi"

/ {
	hisi,boardid = <1 4 1 5 >;
	hisi,boardname = "GRACE_UL_V4_64G";
	hisi,config_profile = "high";

};

